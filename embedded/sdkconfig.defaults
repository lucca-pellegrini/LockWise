## embedded/sdkconfig.defaults
```kconfig
# ESP32-LyraT V4.3 Configuration
CONFIG_ESP_DEFAULT_CPU_FREQ_MHZ_240=y

# Flash Configuration
CONFIG_ESPTOOLPY_FLASHSIZE_4MB=y
CONFIG_ESPTOOLPY_FLASHSIZE="4MB"

# Audio HAL Configuration
CONFIG_ESP_LYRAT_V4_3_BOARD=y

# FreeRTOS Configuration
CONFIG_FREERTOS_HZ=1000
CONFIG_FREERTOS_TIMER_TASK_STACK_DEPTH=3072
CONFIG_FREERTOS_ENABLE_BACKWARD_COMPATIBILITY=y

# WiFi Configuration
CONFIG_ESP_WIFI_DYNAMIC_TX_BUFFER_NUM=32
CONFIG_ESP_WIFI_STATIC_RX_BUFFER_NUM=16
CONFIG_ESP_WIFI_DYNAMIC_RX_BUFFER_NUM=32

# MQTT Configuration
CONFIG_MQTT_PROTOCOL_311=y
CONFIG_MQTT_TRANSPORT_SSL=y
CONFIG_MQTT_TRANSPORT_WEBSOCKET=n

# HTTP Client Configuration
CONFIG_ESP_HTTP_CLIENT_ENABLE_HTTPS=y

# NVS Configuration
CONFIG_NVS_ENCRYPTION=n

# Partition Table
CONFIG_PARTITION_TABLE_CUSTOM=y
CONFIG_PARTITION_TABLE_CUSTOM_FILENAME="partitions.csv"
CONFIG_PARTITION_TABLE_FILENAME="partitions.csv"

# Memory
CONFIG_SPIRAM=y
CONFIG_SPIRAM_SPEED_80M=y
CONFIG_SPIRAM_USE_MALLOC=y
CONFIG_SPIRAM_MEMTEST=n

# Task WDT
CONFIG_ESP_TASK_WDT_TIMEOUT_S=10

# Log level
CONFIG_LOG_DEFAULT_LEVEL_INFO=y

# Disable unused ADF components to save memory
CONFIG_AUDIO_RECORDER_ENABLED=n
CONFIG_DISPLAY_SERVICE_ENABLED=n
CONFIG_BLUETOOTH_SERVICE_ENABLED=n
CONFIG_INPUT_KEY_SERVICE_ENABLED=n
CONFIG_BATTERY_SERVICE_ENABLED=n
CONFIG_CLOUD_SERVICE_ENABLED=n
CONFIG_WIFI_SERVICE_ENABLED=n
CONFIG_OTA_SERVICE_ENABLED=n

# Allow mbedTLS to allocate on SPIRAM, which releases a bunch of pages
CONFIG_MBEDTLS_INTERNAL_MEM_ALLOC=n
CONFIG_MBEDTLS_EXTERNAL_MEM_ALLOC=y
CONFIG_MBEDTLS_DEFAULT_MEM_ALLOC=n
CONFIG_MBEDTLS_CUSTOM_MEM_ALLOC=n
```

## embedded/voice_lock_system/main/Kconfig.projbuild
```kconfig
menu "LockWise Configuration"

    config WIFI_SSID
        string "WiFi SSID"
        default "YourWiFiSSID"
        help
            WiFi SSID (network name) for the device to connect to.

    config WIFI_PASSWORD
        string "WiFi Password"
        default "YourWiFiPassword"
        help
            WiFi password (WPA or WPA2) for the device to use.

    config DEVICE_ID
        string "Device ID"
        default "lockwise_device_001"
        help
            Unique identifier for this lock device.

    config BACKEND_URL
        string "Backend API URL"
        default "http://your-backend-server.com/api/verify-voice"
        help
            URL of the backend API endpoint for voice verification.

    config MQTT_BROKER_URL
        string "MQTT Broker URL"
        default "mqtt://your-mqtt-broker.com"
        help
            URL of the MQTT broker for remote control.

    config LOCK_GPIO
        int "Lock Control GPIO Pin"
        default 13
        help
            GPIO pin for controlling the lock (-1 to disable).

    config MQTT_HEARTBEAT_ENABLE
        bool "Enable MQTT Heartbeat"
        default y
        help
            Enable periodic heartbeat messages to MQTT status topic.

    config MQTT_HEARTBEAT_INTERVAL_SEC
        int "MQTT Heartbeat Interval (seconds)"
        depends on MQTT_HEARTBEAT_ENABLE
        default 30
        range 5 3600
        help
            Interval in seconds between heartbeat messages (5-3600 seconds).

    config AUDIO_RECORD_TIMEOUT_SEC
        int "Audio Recording Timeout (seconds)"
        default 5
        range 1 60
        help
            Maximum duration for audio recording in seconds.

    config LOCK_TIMEOUT_MS
        int "Lock Auto-Lock Timeout (milliseconds)"
        default 20000
        range 5000 300000
        help
            Time in milliseconds after unlocking before auto-locking the door.

endmenu
```

## embedded/voice_lock_system/sdkconfig.defaults
```kconfig
# ESP32-LyraT V4.3 Configuration
CONFIG_ESP_DEFAULT_CPU_FREQ_MHZ_240=y

# Flash Configuration
CONFIG_ESPTOOLPY_FLASHSIZE_4MB=y
CONFIG_ESPTOOLPY_FLASHSIZE="4MB"

# Audio HAL Configuration
CONFIG_ESP_LYRAT_V4_3_BOARD=y

# FreeRTOS Configuration
CONFIG_FREERTOS_HZ=1000
CONFIG_FREERTOS_TIMER_TASK_STACK_DEPTH=3072
CONFIG_FREERTOS_ENABLE_BACKWARD_COMPATIBILITY=y

# WiFi Configuration
CONFIG_ESP_WIFI_DYNAMIC_TX_BUFFER_NUM=32
CONFIG_ESP_WIFI_STATIC_RX_BUFFER_NUM=16
CONFIG_ESP_WIFI_DYNAMIC_RX_BUFFER_NUM=32

# MQTT Configuration
CONFIG_MQTT_PROTOCOL_311=y
CONFIG_MQTT_TRANSPORT_SSL=n
CONFIG_MQTT_TRANSPORT_WEBSOCKET=n

# HTTP Client Configuration
CONFIG_ESP_HTTP_CLIENT_ENABLE_HTTPS=n

# NVS Configuration
CONFIG_NVS_ENCRYPTION=n

# Partition Table
CONFIG_PARTITION_TABLE_CUSTOM=y
CONFIG_PARTITION_TABLE_CUSTOM_FILENAME="partitions.csv"
CONFIG_PARTITION_TABLE_FILENAME="partitions.csv"

# Memory
CONFIG_SPIRAM=y
CONFIG_SPIRAM_SPEED_80M=y
CONFIG_SPIRAM_USE_MALLOC=y
CONFIG_SPIRAM_MEMTEST=n

# Task WDT
CONFIG_ESP_TASK_WDT_TIMEOUT_S=10

# Log level
CONFIG_LOG_DEFAULT_LEVEL_INFO=y
```
